## drivers/s10-camera-v4l2/Kconfig
```kconfig
# SPDX-License-Identifier: GPL-2.0-only
config VIDEO_S10_CAMERA
	tristate "Samsung S10+ (Exynos 9820) native camera drivers"
	depends on MEDIA_CONTROLLER && VIDEO_V4L2_SUBDEV_API && VIDEO_V4L2
	select V4L2_FWNODE
	select VIDEOBUF2_DMA_CONTIG
	help
	  Native standard-V4L2 drivers for the Galaxy S10+/S10 (Exynos 9820)
	  MIPI CSI-2 camera path: exynos9820-csis (CSIS+DMA), the Samsung S5K
	  image sensors, and the AK7374 lens actuator. This produces RAW10
	  Bayer video nodes via videobuf2 DMA-contig.

	  Say Y (or M) to enable the Nuxel native camera. The vendor FIMC-IS2
	  driver is independent and can be left enabled as a rollback.
```
