/dts-v1/;

/ {
    compatible = "samsung,armv8", "samsung,exynos9820";
    #address-cells = <0x02>;
    #size-cells = <0x01>;
    model = "Samsung BEYOND2LTE EUR OPEN 26 board based on EXYNOS9820";

    fimc_is@17190000 {
        compatible = "samsung,exynos5-fimc-is";
        reg = <0x00 0x17190000 0x10000>;
    };
};
